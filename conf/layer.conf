## conf/layer.conf
```bitbake
BBPATH := "${BBPATH}:${LAYERDIR}" 

BBFILES := "${BBFILES} ${LAYERDIR}/recipes-*/*/*.bb \ 
           ${LAYERDIR}/recipes-*/*/*.bbappend \
	   ${LAYERDIR}/images/*.bb*"


BBFILE_COLLECTIONS += "tpm2d-fde" 
BBFILE_PATTERN_tpm2d-fde := "^${LAYERDIR}/" 
BBFILE_PRIORITY_tpm2d-fde := "8"
```
